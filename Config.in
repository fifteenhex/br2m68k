## Config.in
```kconfig
source "$BR2_EXTERNAL_M68K_PATH/package/bstoolbox/Config.in"
source "$BR2_EXTERNAL_M68K_PATH/package/emile/Config.in"
source "$BR2_EXTERNAL_M68K_PATH/package/emile-bootloader/Config.in"

config BR2_TARGET_ROOTFS_MACCD
        bool "Create a bootable Mac CD image"
	select BR2_PACKAGE_HOST_EMILE
        help
          x
```

## package/emile-bootloader/Config.in
```kconfig
config BR2_PACKAGE_EMILE_BOOTLOADER
	bool "EMILE (bootloader part)"
	help
	  EMILE linux m68k bootloader
```

## package/emile/Config.in
```kconfig
config BR2_PACKAGE_EMILE
	bool "EMILE"
	select BR2_PACKAGE_EMILE_BOOTLOADER
	help
	  EMILE linux m68k bootloader

config BR2_PACKAGE_HOST_EMILE
	bool "EMILE host tools"
	select BR2_PACKAGE_EMILE_BOOTLOADER
	help
	  EMILE host tools
```
